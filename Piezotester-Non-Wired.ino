/*   
Filnavn: Piezotester-Non-Wired.ino
Versjon:  1.0
Revisjon: 1.0 - 26.04.24

Utviklet av Kenneth Paulsen, Jone Johan Johnsen og Kenneth Svalstad Øien på vegne av Water Linked AS og Fagskolen i Viken, 2023/2024.
---Aktuelle datablad og annen relevant informasjon---
Arduino Uno R3 datablad:    https://docs.arduino.cc/resources/datasheets/A000066-datasheet.pdf
TLC555IP datablad:          https://www.ti.com/lit/ds/symlink/tlc555.pdf?ts=1702042437118&ref_url=https%253A%252F%252Fwww.ti.com%252Fproduct%252FTLC555%252Fpart-details%252FTLC555IDR
555 kalkulator:             https://www.digikey.no/en/resources/conversion-calculators/conversion-calculator-555-timer
LED datablad:               https://www.kingbrightusa.com/images/catalog/SPEC/WP59EGC.pdf

Formel tid høyt signal fra 555:   tH = 0.693 *(R1+R2) * C    -->  C1 = tH / (0.693 * (R1+R2) )
Formel tid lavt signal fra 555:   tL = 0.693 * (R2) * C      -->  C1 = tL / (0.693 * R2 )
Formel frekvens:                  f =  1.44 / ( (R1 + (2*R2)) * C )
*/

#include <Adafruit_SSD1306.h>     // Bibliotek for displayet
#include <Fonts/FreeSans9pt7b.h>  // Font


#define SCREEN_WIDTH 128                                                   // Displayets bredde i piksler
#define SCREEN_HEIGHT 64                                                   // Displayets høyde i piksler
#define OLED_RESET -1                                                      // -1 er verdien for å resette displayet ved reset av MCUen
#define SCREEN_ADDRESS 0x3D                                                // I2C-adressen til dispalyet. Alternativ adresse er 0x3C
Adafruit_SSD1306 display(SCREEN_WIDTH, SCREEN_HEIGHT, &Wire, OLED_RESET);  // Oppretter et objekt for displayet


const int PULSE_PIN = 2;     // Pulspinne fra 555
const int P_LED_GREEN = 7;   // Grønn LED
const int P_LED_RED = 8;     // Rød LED
const int DATA_BUTTON = 12;  // Knapp

/*
De to følgende arrayene er generert på https://javl.github.io/image2cpp/
Variabler lagres normalt sett i arduinoens RAM, men disse arrayene var såpass store at det ikke ble plass. De er til sammen over 2000 byte
Bak arrayet er det skrevet PROGMEM, som er en kommando for å lagre dataen i arduinoens Flash-minne i stedet for RAM.
På denne måten sparer vi plass i arduinoens RAM. 
*/
const unsigned char FiVLogo[] PROGMEM = {
  0x00, 0x00, 0x00, 0x00, 0x00, 0x00, 0x00, 0x00, 0x00, 0x00, 0x00, 0x00, 0x00, 0x00, 0x00, 0x00,
  0x00, 0x00, 0x00, 0x00, 0x00, 0x00, 0x00, 0x00, 0x00, 0x00, 0x00, 0x00, 0x00, 0x00, 0x00, 0x00,
  0x00, 0x00, 0x00, 0x00, 0x00, 0x00, 0x00, 0x00, 0x00, 0x00, 0x00, 0x00, 0x00, 0x00, 0x00, 0x00,
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  0x00, 0x00, 0x00, 0x00, 0x00, 0x00, 0x00, 0x00, 0x00, 0x00, 0x00, 0x00, 0x00, 0x00, 0x00, 0x00
};

const unsigned char WLLogo[] PROGMEM = {
  0x00, 0x00, 0x00, 0x00, 0x00, 0x00, 0x00, 0x00, 0x00, 0x00, 0x00, 0x00, 0x00, 0x00, 0x00, 0x00,
  0x00, 0x00, 0x00, 0x00, 0x00, 0x00, 0x00, 0x00, 0x00, 0x00, 0x00, 0x00, 0x00, 0x00, 0x00, 0x00,
  0x00, 0x00, 0x00, 0x00, 0x00, 0x00, 0x00, 0x00, 0x00, 0x00, 0x00, 0x00, 0x00, 0x00, 0x00, 0x00,
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  0x00, 0x00, 0x00, 0x00, 0x00, 0x00, 0x00, 0x00, 0x00, 0x00, 0x00, 0x00, 0x00, 0x00, 0x00, 0x00
};


int buttonstate;                         // Erklærer variabelen buttonstate
int lastButtonstate = LOW;               // Setter lastButtonstate til LOW
unsigned long lastDebounceTime = 0;      // Erklærer holdevariabel for å lagre tiden
const unsigned long debounceDelay = 20;  // Erklærer tidsintervallet for debouncing av knappen

unsigned long currentTime = 0;  // Erklærer nåtid som 0
unsigned long prevTime = 0;     // Erklærer forige lagrede tid som 0

const unsigned long screensaverTimeout = 300000;  // Timer for å aktivere skjermspareren. 300000 ms = 5 min

const float lowerCapacitanceLimit = 2.1;  // Nedre grense for kapasitans
const float upperCapacitanceLimit = 3.1;  // Øvre grense for kapasitans

bool capFail = true;                  // bool for å registrere godkjent/ikke godkjent kapasitansverdi
bool screensaverTimerActive = false;  // bool for å holde styr på skjermspareren
bool screensaverActive = false;       // bool for å holde styr på skjermspareren

const int cursorYOffset = 7;  // Markør-offset for den største fonten


void setup() {
  const int startupMessageDelay = 2000;  // Tid for hver info-skjerm i startfasen

  Serial.begin(115200);              // Baud rate for UART
  Serial.println("Serial started");  // Til info

  /* 
Forklaring på funksjoner relatert til displayet: 
  display.begin(SSD1306_SWITCHCAPVCC, SCREEN_ADDRESS);  Starter displayet ved VCC på, og spesifisert I2C-adresse
  display.dim(1);                                       Dimmer lysstyrken ned. OBS fungerer kun med autentiske SSD1306-dispaly
  display.ssd1306_command(SSD1306_DISPLAYON);           Skrur på displayet
  display.ssd1306_command(SSD1306_DISPLAYOFF);          Skrur av displayet
  display.drawBitmap(0, 0, FiVLogo, 128, 64, 1);        Tegner bildet (fagskolens logo) fra posisjon 0, 0 innenfor rammen til displayet
  display.clearDisplay();                               Nullstiller alle piksler
  display.setTextSize(1);                               Setter tekststrørrelsen, størrelse 1 i dette tilfellet
  display.setFont();                                    Velger font teksten skal skrives på displayet i
  display.setTextColor(SSD1306_WHITE);                  Velger farge, hvit i dette tilfellet
  display.setCursor(0, 0);                              Flytter markøren til posisjon (X, Y) 
  display.getCurosrY()                                  Henter posisjonen til markøren i Y-aksen
  display.print();                                      Skriver tekst til bufferminnet, uten linjeskift. 
  display.println();                                    Skriver tekst til bufferminnet, med linjeskift
  display.dispaly();                                    Oppdaterer displayet slik at alt som ligger i bufferen blir vist på dispalyet              
*/

  display.begin(SSD1306_SWITCHCAPVCC, SCREEN_ADDRESS);  // Starter displayet ved VCC på, og spesifisert I2C-adresse
  if (SCREEN_ADDRESS == 0x3D) {                         // Billige kopier av displayet har ofte en annen adresse og mangler funksjonen dim().
    display.dim(1);
  }

  for (int i = 2; i <= 19; i++) {  // Setter alle digitale og analoge pinnenr til INPUT_PULLUP, slik at de er i en kjent tilstand
    pinMode(i, INPUT_PULLUP);
  }

  pinMode(PULSE_PIN, INPUT);           // Setter pulspinnen fra 555 til INPUT
  pinMode(DATA_BUTTON, INPUT_PULLUP);  // Setter pinnen til dataknappen til INPUT_PULLUP

  pinMode(P_LED_GREEN, OUTPUT);  // Setter pinnen til det grønne LED-lyset til OUTPUT
  pinMode(P_LED_RED, OUTPUT);    // Setter pinnen til det røde LED-lyset til OUTPUT


  display.clearDisplay();
  display.setTextSize(1);
  display.setTextColor(SSD1306_WHITE);

  // Viser FiV logoen
  display.setCursor(0, 0);
  display.drawBitmap(0, 0, FiVLogo, SCREEN_WIDTH, SCREEN_WIDTH, 1);
  display.display();
  delay(startupMessageDelay);
  display.clearDisplay();

  // Viser Water Linked AS' logo
  display.drawBitmap(0, 0, WLLogo, SCREEN_WIDTH, SCREEN_HEIGHT, 1);
  display.display();
  delay(startupMessageDelay);
  display.clearDisplay();

  // Viser info om programmet
  display.println("Program:");
  display.println("Piezotester-Non-Wired.ino\n");
  display.println("v1.0");
  display.display();
  delay(startupMessageDelay);
  display.clearDisplay();

  display.setCursor(0, 0);
  display.println("Program parameters: ");
  display.println("Baud rate: 115200\n");
  display.print("Lower capacitance\nlimit = ");
  display.print(lowerCapacitanceLimit);
  display.println(" nF\n");
  display.print("Upper capacitance\nlimit = ");
  display.print(upperCapacitanceLimit);
  display.println(" nF\n");
  display.display();
  delay(startupMessageDelay);


  display.setFont(&FreeSans9pt7b);  // Bytter font
  display.clearDisplay();
}  // Setup slutt


void loop() {
  int buttonReading = digitalRead(DATA_BUTTON);  // Leser av dataknappen
  float measuredCapacitance = capacitance();     // Kjører capacitance()-funksjonen og lagrer returnert verdi (float) i measuredCapacitance

  const int displayUpdateTimer = 500;
  unsigned long prevDisplayUpdateTime = 0;
  currentTime = millis();  // Lagrer returnert verdi fra millis() (tid siden MCUen startet)

  //Serial.println(measuredCapacitance);    // Debug

  display.setCursor(0, 12);  // Flytter markøren

  // Printer den målte kapasitansen og viser OK eller FAIL avhenging av resultatet
  display.println("Capacitance: ");
  if (measuredCapacitance >= lowerCapacitanceLimit && measuredCapacitance <= upperCapacitanceLimit) {
    display.println("OK");
    display.print(measuredCapacitance, 2);
    display.print(" nF");
    capFail = false;
  } else {
    display.println("FAIL");
    capFail = true;
  }
  if (measuredCapacitance <= lowerCapacitanceLimit) {
    display.setFont();
    display.setCursor(0, display.getCursorY() - cursorYOffset);
    display.print("Capacitance too low\nor no piezo detected");
    display.setFont(&FreeSans9pt7b);
  }
  if (measuredCapacitance >= upperCapacitanceLimit) {
    display.setFont();
    display.setCursor(0, display.getCursorY() - cursorYOffset);
    display.print("Capacitance too high");
    display.setFont(&FreeSans9pt7b);
  }

  if (currentTime - prevDisplayUpdateTime >= displayUpdateTimer) {
    display.display();  // Oppdaterer displayet om intervallet overskrides
    prevDisplayUpdateTime = currentTime;
  }


  // Leser av knappen med debouncing og sender siste målte kapasitansverdi over UART
  if (buttonReading != lastButtonstate) {  // Hvis buttonReading er noe annet enn lastButtonstate:
    lastDebounceTime = millis();           // Lagrer tid siden oppstart i lastDebounceTime
  }
  if ((millis() - lastDebounceTime) > debounceDelay) {  // Hvis knappen er trykke inn lengre enn debounceDelay (50 ms)
    if (buttonReading != buttonstate) {                 // Hvis buttonReading er noe annet enn buttonstate
      buttonstate = buttonReading;                      // Setter buttonstate til verdien av buttonReading

      if (buttonstate == LOW) {             // Hvis buttonstate er satt til LAV
        Serial.print(measuredCapacitance);  // Sender verdien over UART
        Serial.print(",");
        Serial.print("\n");

        display.clearDisplay();
        display.setCursor(0, 40);
        display.print("Sending value");
        display.display();

        // loop som animerer "..."
        for (int i = 0; i <= 2; i++) {
          display.print(".");
          display.display();
          delay(333);
        }
      }
    }
  }
  lastButtonstate = buttonReading;

  // Skjermsparer
  if (capFail && !screensaverTimerActive) {                  // Hvis kapasitansen er feil og timeren ikke er aktiv
    prevTime = currentTime;                                  // Oppdaterer nåtiden
    screensaverTimerActive = true;                           // Aktiverer en av betingelsene til skjermspareren
  } else if (!capFail || digitalRead(DATA_BUTTON) == LOW) {  // Skrur displayet på om kapasitansen er OK eller dataknappen blir trykket inn
    display.ssd1306_command(SSD1306_DISPLAYON);
    screensaverTimerActive = false;  // Skrur av betingelsen for skjermspareren
  }
  if (screensaverTimerActive && (currentTime - prevTime >= screensaverTimeout)) {  // Skrur displayet av om betingelsen møtes
    display.ssd1306_command(SSD1306_DISPLAYOFF);
    screensaverTimerActive = false;  // Skrur av betingelsen for skjermspareren
  }

  display.clearDisplay();
}  // loop slutt



float capacitance() {
  // Verdier og variabler kun brukt i denne funksjonen:
  const float K = 0.693;  // Konstant verdi fra databladet til TLC555IP
  //const float R1 = 100000.0;  // Målt motstand på R1
  const float R2 = 100000.0;       // Målt motstand på R2
  const int measurments = 9;       // Antall målinger som utføres
  float C1 = 0.0;                  // Kapasitans
  float sum = 0.0;                 // Sum til snittmåling
  float averageCapacitance = 0.0;  // Gjennomsnittlig målt kapasitans

  // Utfører snittmålinger av pulstiden
  for (int i = 0; i < measurments; i++) {
    // Formel tid lavt signal fra 555:   tL = 0.693 * (R2) * C      -->  C1 = tL / (0.693 * R2)
    unsigned long tL = pulseIn(PULSE_PIN, LOW);  // Måler tiden pulsen er lav [us]
    C1 = (float(tL) / 1.0e6f) / (K * R2);        // Regner ut kapasitans.  pulstid [s] / (K * R1[ohm] )
    C1 = C1 * 1.0e9f;                            // Regner om til nF

    sum = sum + C1;
  }
  averageCapacitance = sum / measurments;

  // Tenner enten rød eller grønn LED avhengig av måleresultat
  if (averageCapacitance <= lowerCapacitanceLimit || averageCapacitance >= upperCapacitanceLimit) {
    digitalWrite(P_LED_GREEN, LOW);
    digitalWrite(P_LED_RED, HIGH);
  } else {
    digitalWrite(P_LED_GREEN, HIGH);
    digitalWrite(P_LED_RED, LOW);
  }

  return averageCapacitance;  // Returnerer verdien for kapasitans
}
