/*   
Filnavn: Piezotester-Main.ino
Versjon:  1.0
Revisjon: 1.0 - 11.02.24

Utviklet av Kenneth Paulsen, Jone Johan Johnsen og Kenneth Svalstad Øien på vegne av Water Linked AS og Fagskolen i Viken, 2023/2024.

---Aktuelle datablad og annen relevant informasjon---
Arduino Uno R3 datablad:    https://docs.arduino.cc/resources/datasheets/A000066-datasheet.pdf
TLC555IP datablad:          https://www.ti.com/lit/ds/symlink/tlc555.pdf?ts=1702042437118&ref_url=https%253A%252F%252Fwww.ti.com%252Fproduct%252FTLC555%252Fpart-details%252FTLC555IDR
555 kalkulator:             https://www.digikey.no/en/resources/conversion-calculators/conversion-calculator-555-timer
LED datablad:               https://www.kingbrightusa.com/images/catalog/SPEC/WP59EGC.pdf

Formel tid høyt signal fra 555:   tH = 0.693 *(R1+R2) * C    -->  C1 = tH / (0.693 * (R1+R2) )
Formel tid lavt signal fra 555:   tL = 0.693 * (R2) * C      -->  C1 = tL / (0.693 * R2 )
Formel frekvens:                  f =  1.44 / ( (R1 + (2*R2)) * C )
*/

//#include <SPI.h>
#include <Wire.h>
//#include <Adafruit_GFX.h>
#include <Adafruit_SSD1306.h>
//#include <Adafruit_SSD1306_EMULATOR.h>
#include <Fonts/FreeSans9pt7b.h>


#define SCREEN_WIDTH 128  // display display width, in pixels
#define SCREEN_HEIGHT 64  // display display height, in pixels
#define OLED_RESET -1     // Reset pin # (or -1 if sharing Arduino reset pin)
#define SCREEN_ADDRESS 0x3D  ///< See datasheet for Address; 0x3D for 128x64, 0x3C for 128x32
//#define SCREEN_ADDRESS 0x3C  ///< See datasheet for Address; 0x3D for 128x64, 0x3C for 128x32
Adafruit_SSD1306 display(SCREEN_WIDTH, SCREEN_HEIGHT, &Wire, OLED_RESET);
//Adafruit_SSD1306_EMULATOR display(SCREEN_WIDTH, SCREEN_HEIGHT, &Wire, OLED_RESET);

const int PULSE_PIN = 2;
const int W1_LED_GREEN = 3;  // Right LED
const int W1_LED_RED = 4;    // Right LED
const int W2_LED_GREEN = 5;  // Left LED
const int W2_LED_RED = 6;    // Left LED
const int P_LED_GREEN = 7;   // Piezo LED
const int P_LED_RED = 8;     // Piezo LED

const int W1_CONT_CHK = A0;
const int W2_CONT_CHK = A1;

const int BUTTON_PIN = 12;

const unsigned char FiVLogo[] PROGMEM = {
  0x00, 0x00, 0x00, 0x00, 0x00, 0x00, 0x00, 0x00, 0x00, 0x00, 0x00, 0x00, 0x00, 0x00, 0x00, 0x00,
  0x00, 0x00, 0x00, 0x00, 0x00, 0x00, 0x00, 0x00, 0x00, 0x00, 0x00, 0x00, 0x00, 0x00, 0x00, 0x00,
  0x00, 0x00, 0x00, 0x00, 0x00, 0x00, 0x00, 0x00, 0x00, 0x00, 0x00, 0x00, 0x00, 0x00, 0x00, 0x00,
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  0x00, 0x00, 0x00, 0x00, 0x00, 0x00, 0x00, 0x00, 0x00, 0x00, 0x00, 0x00, 0x00, 0x00, 0x00, 0x00
};  // https://javl.github.io/image2cpp/
/* 
ChatGPT sier:
In Arduino programming, PROGMEM stands for "program memory." It is a keyword used to store data in the flash memory of the microcontroller instead of the RAM. 
In microcontrollers like those used in Arduino boards, there are different types of memory:
  1. Flash Memory: This is where the program code is stored.
  2. RAM (Random Access Memory): This is used for variables during program execution. When you use the PROGMEM keyword in an Arduino sketch, you are 
indicating that the data should be stored in the flash memory instead of RAM. This is particularly useful when dealing with large arrays or constants that 
do not change during program execution. Storing data in flash memory helps to conserve RAM, which is often limited in microcontrollers. 
*/
const unsigned char WLLogo[] PROGMEM = {
  0x00, 0x00, 0x00, 0x00, 0x00, 0x00, 0x00, 0x00, 0x00, 0x00, 0x00, 0x00, 0x00, 0x00, 0x00, 0x00,
  0x00, 0x00, 0x00, 0x00, 0x00, 0x00, 0x00, 0x00, 0x00, 0x00, 0x00, 0x00, 0x00, 0x00, 0x00, 0x00,
  0x00, 0x00, 0x00, 0x00, 0x00, 0x00, 0x00, 0x00, 0x00, 0x00, 0x00, 0x00, 0x00, 0x00, 0x00, 0x00,
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  0x00, 0x00, 0x00, 0x00, 0x00, 0x00, 0x00, 0x00, 0x00, 0x00, 0x00, 0x00, 0x00, 0x00, 0x00, 0x00
};  // https://javl.github.io/image2cpp/


int buttonState;
int lastButtonState = LOW;
unsigned long lastDebounceTime = 0;
unsigned long debounceDelay = 50;

unsigned long prevTime = 0;
const long screensaverTimeout = 15000;  // 300000 = 5 minutes
unsigned long screensaverStartTime = millis();

const float lowerCapacitanceLimit = 1.9;
const float upperCapacitanceLimit = 3.8;

int ADCThreshold = 500;

bool W1Fail = false;
bool W2Fail = false;
bool capFail = false;

void setup() {
  Serial.begin(115200);
  Serial.println("Serial started");
  Wire.begin();
  display.begin(SSD1306_SWITCHCAPVCC, SCREEN_ADDRESS);
  if (SCREEN_ADDRESS == 0x3D) {
    display.dim(1);  // Dims display down
  }

  display.clearDisplay();
  display.setTextSize(1);
  display.setTextColor(SSD1306_WHITE);
  display.setCursor(0, 0);
  display.drawBitmap(0, 0, FiVLogo, 128, 64, 1);
  display.display();
  delay(2000);
  display.clearDisplay();
  display.drawBitmap(0, 0, WLLogo, 128, 64, 1);
  display.display();
  delay(2000);
  display.clearDisplay();
  display.println("Piezotester-Main.ino\n");
  display.println("v1.0\n\n");
  display.println("Baud rate: 115200");
  display.display();
  delay(2000);

  display.setFont(&FreeSans9pt7b);  // CUSTOM FONT

  pinMode(PULSE_PIN, INPUT);

  pinMode(W1_CONT_CHK, INPUT);
  pinMode(W2_CONT_CHK, INPUT);

  pinMode(BUTTON_PIN, INPUT_PULLUP);

  for (int i = 3; i <= 8; i++) {
    pinMode(i, OUTPUT);
  }
  
}

void loop() {
  int cursorY = 0;
  const int cursorX = 67;

  float measuredCapacitance = capacitance();

  display.setCursor(0, 12);

  display.print("Cap.: ");
  if (measuredCapacitance >= lowerCapacitanceLimit && measuredCapacitance <= upperCapacitanceLimit) {
    display.print(" OK, ");
    display.setFont();
    display.print(measuredCapacitance, 2);
    display.print("nF");
    display.setFont(&FreeSans9pt7b);  // CUSTOM FONT
    display.println();
    capFail = false;

  } else {
    cursorY = display.getCursorY();
    display.setCursor(cursorX, cursorY);
    display.println("FAIL");
    capFail = true;
  }

  display.print("R. wire: ");
  cursorY = display.getCursorY();
  display.setCursor(cursorX, cursorY);

  if (wireChk(W1_LED_GREEN, W1_LED_RED, W1_CONT_CHK) == 1) {  // Right wire
    display.println("OK");
    W1Fail = false;
  } else {
    display.println("FAIL");
    W1Fail = true;
  }

  display.print("L. wire: ");
  cursorY = display.getCursorY();
  display.setCursor(cursorX, cursorY);

  if (wireChk(W2_LED_GREEN, W2_LED_RED, W2_CONT_CHK) == 1) {  // Left wire
    display.println("OK");
    W2Fail = false;
  } else {
    display.println("FAIL");
    W2Fail = true;
  }
  display.display();


  int buttonReading = digitalRead(BUTTON_PIN);
  if (buttonReading != lastButtonState) {
    lastDebounceTime = millis();
  }
  if ((millis() - lastDebounceTime) > debounceDelay) {
    if (buttonReading != buttonState) {
      buttonState = buttonReading;

      if (buttonState == LOW) {
        Serial.print(measuredCapacitance);
        Serial.print(",");
        Serial.print("\n");

        display.clearDisplay();
        display.setCursor(0, 24);
        display.println("Sending data ");
        display.println("over serial...");
        display.display();
        delay(1000);
      }
    }
  }
  lastButtonState = buttonReading;

/*
  // Screensaver
  if (capFail && W1Fail && W2Fail) {

    if (millis() - screensaverStartTime >= screensaverTimeout) {  // Skru av display
      display.ssd1306_command(SSD1306_DISPLAYOFF);


      if ((wireChk(W1_LED_GREEN, W1_LED_RED, W1_CONT_CHK) == 1) || (wireChk(W2_LED_GREEN, W2_LED_RED, W2_CONT_CHK) == 1) || 
      (capacitance() > 1.0) || (digitalRead(BUTTON_PIN) == LOW)) {
        display.ssd1306_command(SSD1306_DISPLAYON);
        display.display();
        Serial.println("Screensaver interrupted");
      }
    }
  } else {
    screensaverStartTime = millis();
    //display.ssd1306_command(SSD1306_DISPLAYOFF);
  }
*/
  // Reset MCU
  if (millis() >= 4000000000) {  // max unsigned long er 0xffffffff 4 294 967 295
    resetMCU();                  // Er dette virkelig nødvendig?
  }

  display.clearDisplay();
  delay(500);

}  // LOOP END


float capacitance() {
  const float K = 0.693;
  const float R1 = 99900.0;
  const float R2 = 100100.0;
  const int measurments = 9;
  float C1 = 0.0;
  float sum = 0.0;
  float averageCapacitance = 0.0;

  for (int i = 0; i < measurments; i++) {
    unsigned long tH = pulseIn(PULSE_PIN, HIGH);
    C1 = (tH / 1e6) / (K * (R1 + R2));
    C1 = C1 * 1e9;

    sum = sum + C1;
  }
  averageCapacitance = sum / measurments;

  if (averageCapacitance <= lowerCapacitanceLimit || averageCapacitance >= upperCapacitanceLimit) {
    digitalWrite(P_LED_GREEN, LOW);
    digitalWrite(P_LED_RED, HIGH);
  } else {
    digitalWrite(P_LED_GREEN, HIGH);
    digitalWrite(P_LED_RED, LOW);
  }

  return averageCapacitance;
}

bool wireChk(int LED_GREEN_PIN, int LED_RED_PIN, int CONT_CHK_PIN) {

  digitalWrite(LED_RED_PIN, LOW);
  digitalWrite(LED_GREEN_PIN, HIGH);

  if (analogRead(CONT_CHK_PIN) <= ADCThreshold) {  // Leser fra den respektive grønne-LED-kretsen
    digitalWrite(LED_GREEN_PIN, LOW);
    digitalWrite(LED_RED_PIN, HIGH);
    return 0;  // No wire detected
  } else {
    return 1;  // Wire detected
  }
}

void resetMCU() {
  asm volatile("jmp 0");
}
/*  ChatGPT sier:
asm volatile: This is an inline assembly statement in C/C++ code. The volatile keyword tells the compiler not to optimize or
reorder the assembly code, ensuring that the assembly instructions are executed exactly as written.
" jmp 0": This is the actual assembly instruction. jmp stands for "jump," and 0 is the address to jump to. 
In this case, 0 refers to the reset vector, the location in the program memory where the microcontroller starts executing code after a reset.
So, in simpler terms, the resetMCU function is using assembly language to perform a jump instruction (jmp) to the address 0, effectively causing 
a software reset by restarting the program from the beginning.
It's worth noting that performing a software reset in this way is a powerful operation and should be used with caution. 
It's equivalent to pressing the physical reset button on the Arduino board. Make sure your code is designed to handle a reset, and any critical 
initialization is done appropriately in the setup function.
*/
